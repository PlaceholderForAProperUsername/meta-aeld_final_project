## conf/layer.conf
```bitbake
# We have a conf and classes directory, add to BBPATH
BBPATH .= ":${LAYERDIR}"

# We have recipes-* directories, add to BBFILES
BBFILES += "${LAYERDIR}/recipes-*/*/*.bb \
            ${LAYERDIR}/recipes-*/*/*.bbappend"

BBFILE_COLLECTIONS += "aeldfinalproject"
BBFILE_PATTERN_aeldfinalproject = "^${LAYERDIR}/"
BBFILE_PRIORITY_aeldfinalproject = "1"
LAYERVERSION_aeldfinalproject = "1"

LAYERDEPENDS_aeldfinalproject = "core"

LAYERSERIES_COMPAT_aeldfinalproject = "mickledore kirkstone"
```
