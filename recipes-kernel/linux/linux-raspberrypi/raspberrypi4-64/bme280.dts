/dts-v1/;
/plugin/;

/ {
	compatible = "brcm,bcm2708";
	
	fragment@0 {
		target = <&i2c1>;
		__overlay__ {
			status = "okay";
			bme280@76 {
				compatible = "custom,bme280";
				reg = <0x76>;
			};
		};
	};
};
