/dts-v1/;
/plugin/;

/ {
	compatible = "brcm,bcm2835";
	
	fragment@0 {
		target = <&i2c>;
		__overlay__ {
			status = "okay";
			aeldbme280@76 {
				compatible = "custom,aeldbme280";
				reg = <0x76>;
			};
		};
	};
};
